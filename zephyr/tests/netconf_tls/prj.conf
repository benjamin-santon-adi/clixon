## CMakeLists.txt
```
# SPDX-License-Identifier: Apache-2.0

cmake_minimum_required(VERSION 3.20.0)
find_package(Zephyr REQUIRED HINTS $ENV{ZEPHYR_BASE})
project(netconf_tls_test)

target_sources(app PRIVATE src/main.c)
```

## prj.conf
```kconfig
# Clixon NETCONF TLS Test Configuration

# Enable Clixon library and service
CONFIG_CLIXON=y
CONFIG_CLIXON_SERVICE=y
CONFIG_CLIXON_LOG_LEVEL_INF=y

# Enable NETCONF with TLS
CONFIG_CLIXON_NETCONF=y
CONFIG_CLIXON_NETCONF_TLS=y
CONFIG_CLIXON_NETCONF_PORT=830

# Networking stack
CONFIG_NETWORKING=y
CONFIG_NET_IPV4=y
CONFIG_NET_TCP=y
CONFIG_NET_SOCKETS=y

# Network configuration for testing
CONFIG_NET_CONFIG_SETTINGS=y
CONFIG_NET_CONFIG_MY_IPV4_ADDR="192.0.2.1"
CONFIG_NET_CONFIG_MY_IPV4_NETMASK="255.255.255.0"

# Increase buffers for TLS
CONFIG_NET_BUF_DATA_SIZE=512
CONFIG_NET_PKT_RX_COUNT=16
CONFIG_NET_PKT_TX_COUNT=16

# Memory configuration
CONFIG_HEAP_MEM_POOL_SIZE=131072
CONFIG_MAIN_STACK_SIZE=8192
CONFIG_SYSTEM_WORKQUEUE_STACK_SIZE=4096

# Logging
CONFIG_LOG=y
CONFIG_LOG_MODE_IMMEDIATE=y
CONFIG_PRINTK=y
CONFIG_EARLY_CONSOLE=y

# POSIX (selected by Clixon automatically)
# CONFIG_POSIX_API=y

# Test-specific settings
CONFIG_TEST=y
```

## boards/eval_adin6310t1lebz_max32690_m4.conf
```kconfig
# Board-specific configuration for eval_adin6310t1lebz/max32690/m4

# Increase heap for TLS operations
CONFIG_HEAP_MEM_POOL_SIZE=131072

# Network configuration
CONFIG_NET_CONFIG_SETTINGS=y
CONFIG_NET_CONFIG_MY_IPV4_ADDR="192.0.2.1"
CONFIG_NET_CONFIG_MY_IPV4_NETMASK="255.255.255.0"
CONFIG_NET_CONFIG_MY_IPV4_GW="192.0.2.254"

# Ethernet driver (L2)
CONFIG_NET_L2_ETHERNET=y

# Increase network buffers
CONFIG_NET_PKT_RX_COUNT=16
CONFIG_NET_PKT_TX_COUNT=16
CONFIG_NET_BUF_RX_COUNT=32
CONFIG_NET_BUF_TX_COUNT=32

# Increase workqueue stack for network processing
CONFIG_SYSTEM_WORKQUEUE_STACK_SIZE=4096
```

## src/main.c
```c
/*
 * Copyright (c) 2024 Benjamin Santon ADI
 *
 * SPDX-License-Identifier: Apache-2.0
 *
 * NETCONF over TLS test application
 */

#include <zephyr/kernel.h>
#include <zephyr/logging/log.h>
#include <zephyr/net/net_if.h>
#include <zephyr/net/net_core.h>
#include <zephyr/net/net_context.h>
#include <zephyr/net/net_mgmt.h>

#ifdef CONFIG_CLIXON_SERVICE
#include "clixon_service.h"
#endif

LOG_MODULE_REGISTER(netconf_test, LOG_LEVEL_INF);

#define TEST_BANNER "======================================"

static struct net_mgmt_event_callback mgmt_cb;

static void iface_cb(struct net_mgmt_event_callback *cb,
		     uint64_t mgmt_event, struct net_if *iface)
{
	ARG_UNUSED(cb);
	
	if (mgmt_event == NET_EVENT_IPV4_ADDR_ADD) {
		LOG_INF("IPv4 address added to interface %d",
			net_if_get_by_iface(iface));
	}
}

int main(void)
{
	struct net_if *iface;
	
	LOG_INF("%s", TEST_BANNER);
	LOG_INF("NETCONF over TLS Test");
	LOG_INF("%s", TEST_BANNER);
	
	/* Get the default network interface */
	iface = net_if_get_default();
	if (!iface) {
		LOG_ERR("No network interface found");
		return -1;
	}
	
	LOG_INF("Network interface: %d", net_if_get_by_iface(iface));
	
	/* Register for network events */
	net_mgmt_init_event_callback(&mgmt_cb, iface_cb,
				      NET_EVENT_IPV4_ADDR_ADD);
	net_mgmt_add_event_callback(&mgmt_cb);
	
#ifdef CONFIG_CLIXON_SERVICE
	/* Wait for Clixon service to initialize */
	k_sleep(K_MSEC(500));
	
	if (clixon_service_is_initialized()) {
		LOG_INF("Clixon service initialized successfully");
		LOG_INF("NETCONF server listening on port %d", 
			CONFIG_CLIXON_NETCONF_PORT);
#ifdef CONFIG_CLIXON_NETCONF_TLS
		LOG_INF("TLS encryption: ENABLED");
#else
		LOG_INF("TLS encryption: DISABLED");
#endif
	} else {
		LOG_ERR("Clixon service failed to initialize");
		return -1;
	}
#endif
	
	LOG_INF("%s", TEST_BANNER);
	LOG_INF("Test ready - waiting for client connections");
	LOG_INF("%s", TEST_BANNER);
	
	/* Keep running to serve NETCONF requests */
	while (1) {
		k_sleep(K_SECONDS(1));
	}
	
	return 0;
}
```
