## Kconfig
```kconfig
config CLIXON
	bool "Clixon YANG-based configuration manager"
	select POSIX_API if !NATIVE_APPLICATION
	select FILE_SYSTEM
	select FILE_SYSTEM_LITTLEFS
	help
	  Enable the Clixon library - a YANG-based configuration manager
	  with interactive CLI, NETCONF and RESTCONF interfaces, an embedded
	  database and transaction mechanism.
	  Requires POSIX API support and a file system (LittleFS).

config CLIXON_SERVICE
	bool "Enable Clixon service auto-initialization"
	default y if CLIXON
	select LOG
	help
	  Enable automatic initialization of Clixon service at boot time
	  using SYS_INIT. The service will be initialized before main().
	  This can be enabled independently for testing even when the full
	  Clixon library is not yet ported.

config CLIXON_SERVICE_INIT_PRIORITY
	int "Clixon service initialization priority"
	default 90
	depends on CLIXON_SERVICE
	help
	  Initialization priority for the Clixon service.
	  Lower values mean earlier initialization.
	  Default is 90 (APPLICATION level, late initialization).

if CLIXON

config CLIXON_DEBUG
	bool "Enable Clixon debug output"
	default n
	help
	  Enable debug logging for Clixon library

endif # CLIXON

if CLIXON || CLIXON_SERVICE

module = CLIXON
module-str = clixon
source "subsys/logging/Kconfig.template.log_config"

endif # CLIXON || CLIXON_SERVICE
```

## zephyr/Kconfig
```kconfig
config CLIXON
	bool "Clixon YANG-based configuration manager"
	select POSIX_API if !NATIVE_APPLICATION
	help
	  Enable the Clixon library - a YANG-based configuration manager
	  with interactive CLI, NETCONF and RESTCONF interfaces, an embedded
	  database and transaction mechanism.
	  Requires POSIX API support.
	  
	  NOTE: Work in progress - only minimal core library compiles.
	  File system support disabled until dependencies resolved.

if CLIXON

module = CLIXON
module-str = clixon
source "subsys/logging/Kconfig.template.log_config"

config CLIXON_NETCONF
	bool "Enable NETCONF support"
	select NETWORKING
	select NET_SOCKETS
	select NET_TCP
	select NET_SOCKETS_POSIX_NAMES
	help
	  Enable NETCONF protocol support in Clixon.
	  Provides network configuration management over TCP.

config CLIXON_NETCONF_TLS
	bool "Enable NETCONF over TLS (RFC 7589)"
	depends on CLIXON_NETCONF
	select MBEDTLS
	select MBEDTLS_ENABLE_HEAP
	select MBEDTLS_TLS_VERSION_1_2
	select MBEDTLS_DTLS
	select MBEDTLS_KEY_EXCHANGE_ALL
	select MBEDTLS_CIPHER_ALL
	select MBEDTLS_CIPHER_AES_ENABLED
	select MBEDTLS_CIPHER_GCM_ENABLED
	select MBEDTLS_CIPHER_CCM_ENABLED
	select MBEDTLS_CIPHER_MODE_CBC_ENABLED
	select MBEDTLS_CIPHER_MODE_CTR_ENABLED
	select MBEDTLS_MAC_ALL_ENABLED
	select MBEDTLS_ENTROPY_C
	select MBEDTLS_CTR_DRBG_ENABLED
	select TLS_CREDENTIALS
	select NET_SOCKETS_SOCKOPT_TLS
	help
	  Enable NETCONF over TLS (also known as NETCONF over SSH in some contexts).
	  Provides secure NETCONF connections using TLS/SSL encryption.
	  Requires mbedTLS library with X.509 support (enabled automatically via key exchange).

config CLIXON_NETCONF_PORT
	int "NETCONF TCP port"
	depends on CLIXON_NETCONF
	default 830
	help
	  TCP port for NETCONF connections.
	  Default is 830 (IANA assigned port for NETCONF over SSH/TLS).

config CLIXON_DATASTORE
	bool "Enable Clixon datastore backend"
	select FILE_SYSTEM
	help
	  Enable Clixon datastore support for persistent configuration storage.
	  Requires filesystem support (LittleFS, FAT, or NVS).
	  Can be used independently of full Clixon library.

if CLIXON_DATASTORE

choice CLIXON_DATASTORE_BACKEND
	prompt "Datastore backend"
	default CLIXON_DATASTORE_LITTLEFS
	help
	  Select the filesystem backend for Clixon datastore.

config CLIXON_DATASTORE_LITTLEFS
	bool "LittleFS"
	select FILE_SYSTEM_LITTLEFS
	select FLASH
	select FLASH_MAP
	help
	  Use LittleFS for Clixon datastore.
	  Provides power-fail safe storage on flash memory.

config CLIXON_DATASTORE_FAT
	bool "FAT filesystem"
	select FILE_SYSTEM_FAT
	help
	  Use FAT filesystem for Clixon datastore.
	  Suitable for SD cards or external storage.

config CLIXON_DATASTORE_NVS
	bool "Non-Volatile Storage (NVS)"
	select NVS
	select FLASH
	help
	  Use Zephyr NVS for Clixon datastore.
	  Key-value storage optimized for embedded systems.

endchoice

config CLIXON_XMLDB_DIR
	string "Datastore directory path"
	default "/lfs/clixon" if CLIXON_DATASTORE_LITTLEFS
	default "/SD:/clixon" if CLIXON_DATASTORE_FAT
	default "/nvs/clixon" if CLIXON_DATASTORE_NVS
	help
	  Directory path for Clixon XML database files.
	  Must be on the selected filesystem backend mount point.

config CLIXON_XMLDB_FORMAT
	string "Datastore format"
	default "xml"
	help
	  Format for datastore files (xml, json, or text).
	  XML is standard and recommended.

config CLIXON_YANG_DIR
	string "YANG modules directory"
	default "/lfs/yang" if CLIXON_DATASTORE_LITTLEFS
	default "/SD:/yang" if CLIXON_DATASTORE_FAT
	default ":memory:" if CLIXON_DATASTORE_NVS
	help
	  Directory containing YANG module files.
	  Use :memory: to embed YANG modules in flash.

endif # CLIXON_DATASTORE

endif # CLIXON

config CLIXON_SERVICE
	bool "Enable Clixon service auto-initialization"
	default y if CLIXON
	select LOG
	help
	  Enable automatic initialization of Clixon service at boot time
	  using SYS_INIT. The service will be initialized before main().
	  This can be enabled independently for testing even when the full
	  Clixon library is not yet ported.

config CLIXON_SERVICE_INIT_PRIORITY
	int "Clixon service initialization priority"
	default 90
	depends on CLIXON_SERVICE
	help
	  Initialization priority for the Clixon service.
	  Lower values mean earlier initialization.
	  Default is 90 (APPLICATION level, late initialization).

if CLIXON

config CLIXON_DEBUG
	bool "Enable Clixon debug output"
	default n
	help
	  Enable debug logging for Clixon library

endif # CLIXON

if CLIXON || CLIXON_SERVICE

module = CLIXON
module-str = clixon
source "subsys/logging/Kconfig.template.log_config"

endif # CLIXON || CLIXON_SERVICE
```

## zephyr/tests/netconf_tls/testcase.yaml
```yaml
tests:
  clixon.netconf_tls:
    tags:
      - net
      - netconf
      - tls
      - clixon
    platform_allow:
      - native_sim
      - qemu_x86
      - eval_adin6310t1lebz/max32690/m4
    integration_platforms:
      - native_sim
    harness: pytest
    harness_config:
      fixture: test_netconf_tls
      pytest_root:
        - "pytest/test_netconf_tls.py"
    min_ram: 64
    timeout: 60
    extra_configs:
      - CONFIG_CLIXON_NETCONF=y
      - CONFIG_CLIXON_NETCONF_TLS=y
      - CONFIG_NET_CONFIG_MY_IPV4_ADDR="192.0.2.1"
      - CONFIG_NET_CONFIG_PEER_IPV4_ADDR="192.0.2.2"
```
